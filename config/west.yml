## config/west.yml
```yaml
manifest:
  remotes:
    - name: zmkfirmware
      url-base: https://github.com/zmkfirmware
    - name: mentako-ya
      url-base: https://github.com/mentako-ya
  projects:
    - name: zmk
      remote: zmkfirmware
      revision: v0.3.0
      import: app/west.yml
    - name: zmk-pmw3610-driver
      remote: mentako-ya
      revision: main
    - name: zmk-rgbled-widget
      remote: mentako-ya
      revision: fbe6dde8ffa68fdcded1600a66aa18cf12a796fb
  self:
    path: config
```
